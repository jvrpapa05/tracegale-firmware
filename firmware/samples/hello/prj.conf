## CMakeLists.txt
```
# SPDX-FileCopyrightText: 2026 PHITES Embedded Research and Development on Engineering
# SPDX-License-Identifier: Apache-2.0

cmake_minimum_required(VERSION 3.20.0)
find_package(Zephyr REQUIRED HINTS $ENV{ZEPHYR_BASE})
project(tracegale_hello)

target_sources(app PRIVATE src/main.c)
```

## sample.yaml
```
# SPDX-FileCopyrightText: 2026 PHITES Embedded Research and Development on Engineering
# SPDX-License-Identifier: Apache-2.0

sample:
  name: Tracegale hello
  description: Prints the version of the Tracegale firmware stack.
tests:
  sample.tracegale.hello:
    platform_allow:
      - native_sim
      - qemu_cortex_m3
      - qemu_riscv32
    integration_platforms:
      - native_sim
    harness: console
    harness_config:
      type: one_line
      regex:
        - "Tracegale version: [0-9]+\\.[0-9]+\\.[0-9]+"
```

## prj.conf
```kconfig
CONFIG_TRACEGALE=y
```

## src/main.c
```c
/*
 * SPDX-FileCopyrightText: 2026 PHITES Embedded Research and Development on Engineering
 * SPDX-License-Identifier: Apache-2.0
 */

#include <zephyr/sys/printk.h>

#ifdef CONFIG_TRACEGALE
#include <tracegale/version.h>
#endif

int main(void)
{
#ifdef CONFIG_TRACEGALE
	printk("Tracegale version: %s\n", tracegale_version());
#else
	/* Used by the size comparison, which builds with Tracegale off. */
	printk("Tracegale disabled\n");
#endif

	return 0;
}
```
