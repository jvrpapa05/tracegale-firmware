## CMakeLists.txt
```
# SPDX-FileCopyrightText: 2026 PHITES Embedded Research and Development on Engineering
# SPDX-License-Identifier: Apache-2.0

cmake_minimum_required(VERSION 3.20.0)
# Zephyr v4.5 puts the application's git description in its boot banner, which differs between a git checkout and a copy, so
# CI and local builds had different sizes. A fixed one keeps the sample's image, and the size check, the same everywhere.
set(APP_BUILD_VERSION "sample")
find_package(Zephyr REQUIRED HINTS $ENV{ZEPHYR_BASE})
project(tracegale_connect)

target_sources(app PRIVATE src/main.c)
```

## prj.conf
```kconfig
# SPDX-FileCopyrightText: 2026 PHITES Embedded Research and Development on Engineering
# SPDX-License-Identifier: Apache-2.0

# The only line Tracegale needs.
CONFIG_TRACEGALE=y

# The rest is what the application would have anyway: its connection, and somewhere to keep settings.
CONFIG_NETWORKING=y
CONFIG_NET_IPV4=y
CONFIG_NET_TCP=y
CONFIG_NET_SOCKETS=y
CONFIG_ENTROPY_GENERATOR=y
CONFIG_SHELL=y
CONFIG_FLASH=y
CONFIG_FLASH_MAP=y
CONFIG_NVS=y
CONFIG_SETTINGS=y
CONFIG_SETTINGS_NVS=y
CONFIG_ZVFS_OPEN_MAX=8
CONFIG_LOG=y
```

## overlay-cellular.conf
```kconfig
# SPDX-FileCopyrightText: 2026 PHITES Embedded Research and Development on Engineering
# SPDX-License-Identifier: Apache-2.0
#
# A cellular link through Zephyr's own generic modem driver, which brings up PPP over the modem that the board's devicetree
# describes. This names no board or modem: it's what any application with a cellular link would have, and Tracegale adds
# nothing to it. Set the access point name for your SIM with CONFIG_MODEM_CELLULAR_APN.
CONFIG_NET_L2_PPP=y
CONFIG_NET_L2_PPP_OPTION_DNS_USE=y
CONFIG_DNS_RESOLVER=y
CONFIG_NET_MGMT=y
CONFIG_NET_MGMT_EVENT=y
CONFIG_NET_CONNECTION_MANAGER=y
CONFIG_MODEM=y
CONFIG_MODEM_CELLULAR=y
CONFIG_PM_DEVICE=y
CONFIG_PM_DEVICE_RUNTIME=y
```

## overlay-nrf-modem.conf
```kconfig
# SPDX-FileCopyrightText: 2026 PHITES Embedded Research and Development on Engineering
# SPDX-License-Identifier: Apache-2.0
#
# A cellular link through Nordic's modem library, in the nRF Connect SDK, for any board with an nRF91 series chip. The modem has
# its own TCP/IP and TLS, so the application needs neither Zephyr's network stack nor a TLS library, and Tracegale adds neither.
# This is what such an application has anyway; Tracegale adds nothing here.
CONFIG_NET_NATIVE=n
CONFIG_NET_TCP=n
CONFIG_NET_CONNECTION_MANAGER=y
CONFIG_NRF_MODEM_LIB_NET_IF=y
CONFIG_NRF_MODEM_LIB_NET_IF_AUTO_START=y
CONFIG_NRF_MODEM_LIB_NET_IF_AUTO_CONNECT=y
# The modem takes new credentials only while its link is off. With the AT shell, "at AT+CFUN=4" turns it off before provisioning,
# and "at AT+CFUN=1" turns it on again after "tracegale commit".
CONFIG_AT_SHELL=y
```

## overlay-qemu-riscv.conf
```kconfig
# SPDX-FileCopyrightText: 2026 PHITES Embedded Research and Development on Engineering
# SPDX-License-Identifier: Apache-2.0

# qemu_riscv32, with Zephyr's own network stack and QEMU's user-mode network through a virtio network device. Not secure.
# Unlike overlay-qemu.conf, nothing is trimmed: Tracegale's thread has its default stack, so the run measures what a TLS
# handshake really uses on RISC-V.
CONFIG_NET_QEMU_ETHERNET=y
CONFIG_NET_L2_ETHERNET=y
CONFIG_NET_CONFIG_SETTINGS=y
CONFIG_NET_CONFIG_NEED_IPV4=y
CONFIG_NET_CONFIG_MY_IPV4_ADDR="10.0.2.15"
CONFIG_NET_CONFIG_MY_IPV4_GW="10.0.2.2"
CONFIG_NET_CONFIG_MY_IPV4_NETMASK="255.255.255.0"
CONFIG_DNS_RESOLVER=y
# QEMU keeps locked memory-protection entries through a reset, which real chips clear. The restarted image then can't run, so
# the crash would never be sent. On this emulator only, memory protection is off.
CONFIG_RISCV_PMP=n
# No flash on this target, so provisioning lasts until reset.
CONFIG_SETTINGS=n
CONFIG_SETTINGS_NVS=n
CONFIG_NVS=n
CONFIG_FLASH_MAP=n
CONFIG_FLASH=n
# The commands that crash on purpose, for the tests.
CONFIG_TRACEGALE_SHELL_TEST=y
CONFIG_SHELL_STACK_SIZE=4096
CONFIG_LOG=n
CONFIG_INIT_STACKS=y
CONFIG_THREAD_STACK_INFO=y

# A simulator or emulator, whose random numbers needn't be secure. Never in a product.
CONFIG_TRACEGALE_INSECURE_RANDOM_FOR_TESTS=y
```

## overlay-qemu.conf
```kconfig
# SPDX-FileCopyrightText: 2026 PHITES Embedded Research and Development on Engineering
# SPDX-License-Identifier: Apache-2.0

# qemu_cortex_m3, with Zephyr's own network stack, QEMU's user-mode network and 64 KB of RAM. Not secure.
CONFIG_NET_QEMU_ETHERNET=y
CONFIG_NET_L2_ETHERNET=y
CONFIG_ETH_STELLARIS=y
CONFIG_NET_CONFIG_SETTINGS=y
CONFIG_NET_CONFIG_NEED_IPV4=y
CONFIG_NET_CONFIG_MY_IPV4_ADDR="10.0.2.15"
CONFIG_NET_CONFIG_MY_IPV4_GW="10.0.2.2"
CONFIG_NET_CONFIG_MY_IPV4_NETMASK="255.255.255.0"
CONFIG_DNS_RESOLVER=y
CONFIG_DNS_RESOLVER_MAX_SERVERS=1
CONFIG_DNS_NUM_CONCUR_QUERIES=1
CONFIG_TEST_RANDOM_GENERATOR=y
# No flash partition on this target, so provisioning lasts until reset.
CONFIG_SETTINGS=n
CONFIG_SETTINGS_NVS=n
CONFIG_NVS=n
CONFIG_FLASH_MAP=n
CONFIG_FLASH=n
# Trimmed to fit, and to find out what is really used. Zephyr v4.4's TLS needs all of it.
CONFIG_MBEDTLS_HEAP_SIZE=12000
# 1,296 bytes were left at its deepest, sending a crash, before this was cut from 4,096 to fit the link switch and check-in wait.
CONFIG_TRACEGALE_STACK_SIZE=4000
# Certificates from the Tracegale server are about 406 bytes.
CONFIG_TRACEGALE_CRED_MAX_SIZE=448
# Crash reports, with a smaller store than the default 2 KB, and the commands that crash on purpose for the tests.
CONFIG_TRACEGALE_CRASH_RAM_SIZE=1536
CONFIG_TRACEGALE_SHELL_TEST=y
CONFIG_SHELL_STACK_SIZE=2048
CONFIG_LOG=n
CONFIG_SHELL_VT100_COMMANDS=n
CONFIG_SHELL_HISTORY=n
CONFIG_SHELL_TAB=n
CONFIG_SHELL_WILDCARD=n
CONFIG_NET_BUF_RX_COUNT=12
CONFIG_NET_BUF_TX_COUNT=12
CONFIG_NET_PKT_RX_COUNT=7
CONFIG_NET_PKT_TX_COUNT=7
CONFIG_NET_MAX_CONTEXTS=3
CONFIG_NET_MAX_CONN=3
CONFIG_ZVFS_OPEN_MAX=5
CONFIG_NET_MGMT_EVENT_QUEUE_SIZE=3
CONFIG_INIT_STACKS=y
CONFIG_THREAD_STACK_INFO=y
CONFIG_MAIN_STACK_SIZE=1536
CONFIG_ISR_STACK_SIZE=1536

# A simulator or emulator, whose random numbers needn't be secure. Never in a product.
CONFIG_TRACEGALE_INSECURE_RANDOM_FOR_TESTS=y
```

## overlay-sim-v3.conf
```kconfig
# SPDX-FileCopyrightText: 2026 PHITES Embedded Research and Development on Engineering
# SPDX-License-Identifier: Apache-2.0

# The same as overlay-sim.conf, for Zephyr v3.7's option names. Not secure.
CONFIG_ETH_NATIVE_POSIX=n
CONFIG_NET_DRIVERS=y
CONFIG_NET_SOCKETS_OFFLOAD=y
CONFIG_NET_NATIVE_OFFLOADED_SOCKETS=y
CONFIG_HEAP_MEM_POOL_SIZE=8192
CONFIG_TEST_RANDOM_GENERATOR=y
CONFIG_NATIVE_UART_0_ON_STDINOUT=y
CONFIG_SHELL_VT100_COMMANDS=n
CONFIG_SHELL_BACKEND_SERIAL_RX_RING_BUFFER_SIZE=1024

# A simulator or emulator, whose random numbers needn't be secure. Never in a product.
CONFIG_TRACEGALE_INSECURE_RANDOM_FOR_TESTS=y
```

## overlay-sim.conf
```kconfig
# SPDX-FileCopyrightText: 2026 PHITES Embedded Research and Development on Engineering
# SPDX-License-Identifier: Apache-2.0

# native_sim on Zephyr v4: reaches servers on this machine through its sockets, with the shell on stdin and stdout. Not secure.
CONFIG_ETH_NATIVE_TAP=n
CONFIG_NET_DRIVERS=y
CONFIG_NET_SOCKETS_OFFLOAD=y
CONFIG_NET_NATIVE_OFFLOADED_SOCKETS=y
CONFIG_TEST_RANDOM_GENERATOR=y
CONFIG_UART_NATIVE_PTY_0_ON_STDINOUT=y
CONFIG_SHELL_VT100_COMMANDS=n
CONFIG_SHELL_BACKEND_SERIAL_RX_RING_BUFFER_SIZE=1024

# A simulator or emulator, whose random numbers needn't be secure. Never in a product.
CONFIG_TRACEGALE_INSECURE_RANDOM_FOR_TESTS=y
```

## src/main.c
```c
/*
 * SPDX-FileCopyrightText: 2026 PHITES Embedded Research and Development on Engineering
 * SPDX-License-Identifier: Apache-2.0
 *
 * Tracegale needs no code in the application. Provision the device through the shell, or call the tracegale_provision functions.
 */

int main(void)
{
	return 0;
}
```
