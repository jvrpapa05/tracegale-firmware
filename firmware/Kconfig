## firmware/tests/core/testcase.yaml
```yaml
# SPDX-FileCopyrightText: 2026 PHITES Embedded Research and Development on Engineering
# SPDX-License-Identifier: Apache-2.0

tests:
  tracegale.core:
    platform_allow:
      - native_sim
      - qemu_cortex_m3
      - qemu_riscv32
    integration_platforms:
      - native_sim
```

## firmware/tests/link/testcase.yaml
```yaml
# SPDX-FileCopyrightText: 2026 PHITES Embedded Research and Development on Engineering
# SPDX-License-Identifier: Apache-2.0

tests:
  tracegale.link:
    platform_allow:
      - native_sim
    integration_platforms:
      - native_sim
```

## firmware/tests/logs/testcase.yaml
```yaml
# SPDX-FileCopyrightText: 2026 PHITES Embedded Research and Development on Engineering
# SPDX-License-Identifier: Apache-2.0

tests:
  tracegale.logs:
    platform_allow:
      - native_sim
      - qemu_cortex_m3
      - qemu_riscv32
    integration_platforms:
      - native_sim
  tracegale.logs.deferred:
    extra_args:
      - EXTRA_CONF_FILE=deferred.conf
    platform_allow:
      - native_sim
      - qemu_cortex_m3
    integration_platforms:
      - native_sim
  tracegale.logs.small:
    extra_args:
      - EXTRA_CONF_FILE=small.conf
    platform_allow:
      - native_sim
    integration_platforms:
      - native_sim
  tracegale.logs.off:
    extra_args:
      - EXTRA_CONF_FILE=off.conf
    platform_allow:
      - native_sim
    integration_platforms:
      - native_sim
```

## firmware/tests/metrics/testcase.yaml
```yaml
# SPDX-FileCopyrightText: 2026 PHITES Embedded Research and Development on Engineering
# SPDX-License-Identifier: Apache-2.0

tests:
  # What one line gives: CONFIG_TRACEGALE=y and nothing else.
  tracegale.metrics:
    platform_allow:
      - native_sim
      - qemu_cortex_m3
      - qemu_riscv32
    integration_platforms:
      - native_sim
  # With a heap and thread run times, which the application turns on.
  tracegale.metrics.full:
    extra_args:
      - EXTRA_CONF_FILE=full.conf
    platform_allow:
      - native_sim
      - qemu_cortex_m3
      - qemu_riscv32
    integration_platforms:
      - native_sim
  tracegale.metrics.minimal:
    extra_args:
      - EXTRA_CONF_FILE=minimal.conf
    platform_allow:
      - native_sim
    integration_platforms:
      - native_sim
  tracegale.metrics.net:
    extra_args:
      - EXTRA_CONF_FILE=net.conf
    platform_allow:
      - native_sim
    integration_platforms:
      - native_sim
  tracegale.metrics.off:
    extra_args:
      - EXTRA_CONF_FILE=off.conf
    platform_allow:
      - native_sim
    integration_platforms:
      - native_sim
```

## firmware/tests/module/testcase.yaml
```yaml
# SPDX-FileCopyrightText: 2026 PHITES Embedded Research and Development on Engineering
# SPDX-License-Identifier: Apache-2.0

tests:
  tracegale.module:
    platform_allow:
      - native_sim
      - qemu_cortex_m3
      - qemu_riscv32
    integration_platforms:
      - native_sim
```

## firmware/tests/netwake/testcase.yaml
```yaml
# SPDX-FileCopyrightText: 2026 PHITES Embedded Research and Development on Engineering
# SPDX-License-Identifier: Apache-2.0

tests:
  tracegale.netwake:
    platform_allow:
      - native_sim
    integration_platforms:
      - native_sim
```
