## CMakeLists.txt
```
# SPDX-FileCopyrightText: 2026 PHITES Embedded Research and Development on Engineering
# SPDX-License-Identifier: Apache-2.0

cmake_minimum_required(VERSION 3.20.0)
find_package(Zephyr REQUIRED HINTS $ENV{ZEPHYR_BASE})
project(tracegale_logs_test)

target_include_directories(app PRIVATE ${ZEPHYR_TRACEGALE_MODULE_DIR}/firmware/src)
target_sources(app PRIVATE src/fake.c)
if(CONFIG_TRACEGALE_LOGS)
  target_sources(app PRIVATE src/main.c)
else()
  target_sources(app PRIVATE src/off.c)
endif()
```

## prj.conf
```kconfig
# SPDX-FileCopyrightText: 2026 PHITES Embedded Research and Development on Engineering
# SPDX-License-Identifier: Apache-2.0

CONFIG_ZTEST=y
CONFIG_TRACEGALE=y
CONFIG_TRACEGALE_TRANSPORT_CUSTOM=y
CONFIG_TRACEGALE_AUTOSTART=n
CONFIG_TEST_RANDOM_GENERATOR=y
CONFIG_ENTROPY_GENERATOR=y
# So the buffer for messages is its smallest, 256 bytes, which tests splitting.
CONFIG_TRACEGALE_CRASH=n
CONFIG_ZTEST_STACK_SIZE=2048
# Each suite tests one feature.
CONFIG_TRACEGALE_METRICS=n
CONFIG_LOG=y
# Records reach the backend at once, so tests needn't wait for the log thread. deferred.conf tests the other mode.
CONFIG_LOG_MODE_IMMEDIATE=y
```

## deferred.conf
```kconfig
# SPDX-FileCopyrightText: 2026 PHITES Embedded Research and Development on Engineering
# SPDX-License-Identifier: Apache-2.0

# Zephyr's default mode: a thread of its own hands records to the backends.
CONFIG_LOG_MODE_DEFERRED=y
# The test hands records to the backends itself, so it knows when they have arrived. Zephyr's log thread does that
# in a product, which samples/connect and the end-to-end test run.
CONFIG_LOG_PROCESS_THREAD=n
```

## off.conf
```kconfig
# SPDX-FileCopyrightText: 2026 PHITES Embedded Research and Development on Engineering
# SPDX-License-Identifier: Apache-2.0

CONFIG_TRACEGALE_LOGS=n
```

## small.conf
```kconfig
# SPDX-FileCopyrightText: 2026 PHITES Embedded Research and Development on Engineering
# SPDX-License-Identifier: Apache-2.0

# The smallest buffer, and records that can be longer than a whole message.
CONFIG_TRACEGALE_LOGS_BUFFER_SIZE=512
CONFIG_TRACEGALE_LOGS_LINE_MAX=255
```

## src/main.c
```c
/*
 * SPDX-FileCopyrightText: 2026 PHITES Embedded Research and Development on Engineering
 * SPDX-License-Identifier: Apache-2.0
 */

#include <stdio.h>
#include <string.h>
#include <zephyr/kernel.h>
#include <zephyr/logging/log.h>
#include <zephyr/logging/log_ctrl.h>
#include <zephyr/ztest.h>

#include <tracegale/tracegale.h>

#include "core.h"
#include "fake.h"
#include "logs.h"

LOG_MODULE_REGISTER(test, LOG_LEVEL_DBG);

/* In deferred mode, records reach the backend from Zephyr's log thread, a moment later. */
static void flush(void)
{
	fake_flush();
}

/* The records this test logged, from every message the server kept, in the order they arrived. */
static int mine(const struct rec **out, int max)
{
	int n = 0;

	for (int m = 0; m < srv.messages; m++) {
		for (int i = 0; i < srv.msg[m].count; i++) {
			if (strcmp(srv.msg[m].rec[i].module, "test") == 0 && n < max) {
				out[n++] = &srv.msg[m].rec[i];
			}
		}
	}
	return n;
}

static void check_in(void)
{
	flush();
	fake_reset();
	zassert_ok(tg_core_attempt());
	zassert_equal(srv.hellos, 1);
}

ZTEST(logs, test_records_go_with_the_check_in)
{
	const struct rec *r[8];
	struct tracegale_status before, after;
	uint64_t logged_at = k_uptime_get();

	tracegale_get_status(&before);
	LOG_INF("Pump started at %d rpm", 1450);
	LOG_WRN("Pressure %s", "high");
	LOG_ERR("Valve %d stuck", 3);
	LOG_DBG("Below the level Tracegale keeps");
	check_in();
	zassert_true(srv.messages >= 1);
	zassert_equal(mine(r, ARRAY_SIZE(r)), 3);
	zassert_equal(r[0]->level, 3);
	zassert_str_equal(r[0]->text, "Pump started at 1450 rpm");
	zassert_equal(r[1]->level, 2);
	zassert_str_equal(r[1]->text, "Pressure high");
	zassert_equal(r[2]->level, 1);
	zassert_str_equal(r[2]->text, "Valve 3 stuck");
	zassert_true(r[0]->uptime_ms >= logged_at && r[0]->uptime_ms <= k_uptime_get());

	tracegale_get_status(&after);
	zassert_true(after.logs_sent >= before.logs_sent + 3);

	/* Sent once only. */
	check_in();
	zassert_equal(mine(r, ARRAY_SIZE(r)), 0);
}

ZTEST(logs, test_text_is_made_safe)
{
	const struct rec *r[8];
	static const uint8_t data[16];

	/* Straight to the buffer, because the console would pass these bytes to the terminal of whoever runs the test. */
	static const char unsafe[] = "Line one\nline two\x1b[2J \xc3\xa9\n";

	tg_logs_add(3, "test", unsafe, sizeof(unsafe) - 1);
	LOG_HEXDUMP_INF(data, sizeof(data), "Frame");
	check_in();
	zassert_equal(mine(r, ARRAY_SIZE(r)), 2);
	/* A trailing new line goes. Anything else outside printable ASCII becomes "?". */
	zassert_str_equal(r[0]->text, "Line one?line two?[2J ??");
	zassert_str_equal(r[1]->text, "Frame (16 bytes of data)", "a hex dump's bytes stay on the device");
}

ZTEST(logs, test_long_text_is_cut)
{
	const struct rec *r[4];
	char long_text[300];

	memset(long_text, 'x', sizeof(long_text) - 1);
	long_text[sizeof(long_text) - 1] = '\0';
	LOG_WRN("%s", long_text);
	check_in();
	zassert_equal(mine(r, ARRAY_SIZE(r)), 1);
	/* Cut to the configured length, or shorter still where that's longer than a whole message. */
	zassert_true(r[0]->text_len <= CONFIG_TRACEGALE_LOGS_LINE_MAX && r[0]->text_len >= 100, "%zu bytes", r[0]->text_len);
	zassert_true(srv.msg[0].len <= CONFIG_TRACEGALE_MAX_MESSAGE);
}

ZTEST(logs, test_a_lost_reply_sends_the_same_records_again)
{
	const struct rec *r[8];
	uint32_t first_seq, boot;

	LOG_INF("Before the connection broke");
	flush();
	fake_reset();
	srv.lose_at = 1;
	zassert_equal(tg_core_attempt(), -TRACEGALE_ERR_TIMEOUT);
	zassert_equal(mine(r, ARRAY_SIZE(r)), 1);
	first_seq = r[0]->seq;
	boot = srv.msg[0].boot;

	LOG_INF("After");
	check_in();
	zassert_equal(mine(r, ARRAY_SIZE(r)), 2);
	zassert_equal(r[0]->seq, first_seq, "the same record, with the same seq, so the server stores it once");
	zassert_str_equal(r[0]->text, "Before the connection broke");
	zassert_str_equal(r[1]->text, "After");
	zassert_equal(srv.msg[0].boot, boot, "one start, one boot");
}

ZTEST(logs, test_a_busy_server_gets_them_later)
{
	const struct rec *r[8];
	struct tracegale_status status;

	LOG_INF("Kept for later");
	flush();
	fake_reset();
	srv.refuse_at = 1;
	srv.refuse_code = 12;
	zassert_ok(tg_core_attempt(), "a refusal never fails the check-in");
	tracegale_get_status(&status);
	zassert_equal(status.last_server_error, 12);
	check_in();
	zassert_equal(mine(r, ARRAY_SIZE(r)), 1);
	zassert_str_equal(r[0]->text, "Kept for later");
}

ZTEST(logs, test_a_refusal_for_good_drops_them)
{
	const struct rec *r[8];

	LOG_INF("A server older than logs can't take this");
	flush();
	fake_reset();
	srv.refuse_at = 1;
	srv.refuse_code = 3;
	zassert_ok(tg_core_attempt());
	check_in();
	zassert_equal(mine(r, ARRAY_SIZE(r)), 0);
}

ZTEST(logs, test_a_full_buffer_drops_the_oldest)
{
	const struct rec *r[MAX_MESSAGES * MAX_RECORDS];
	struct tg_logs_state state;
	int n, total = CONFIG_TRACEGALE_LOGS_BUFFER_SIZE / 16;
	uint32_t dropped = 0;

	for (int i = 0; i < total; i++) {
		LOG_INF("Record number %04d, which takes some room", i);
		if (IS_ENABLED(CONFIG_LOG_MODE_DEFERRED) && i % 8 == 0) {
			flush();
		}
	}
	flush();
	tg_logs_state_get(&state);
	zassert_true(state.dropped > 0, "the buffer can't hold %d records", total);
	zassert_true(state.used <= CONFIG_TRACEGALE_LOGS_BUFFER_SIZE);
	check_in();
	n = mine(r, ARRAY_SIZE(r));
	zassert_true(n > 0 && n < total);
	char newest[64];

	snprintf(newest, sizeof(newest), "Record number %04d, which takes some room", total - 1);
	zassert_str_equal(r[n - 1]->text, newest, "the newest records are the ones kept");
	for (int m = 0; m < srv.messages; m++) {
		dropped += srv.msg[m].dropped;
	}
	zassert_true(dropped >= state.dropped, "the server hears how many were lost");

	/* Once the server knows, it isn't told again. */
	check_in();
	for (int m = 0; m < srv.messages; m++) {
		zassert_false(srv.msg[m].has_dropped);
	}
}

ZTEST(logs, test_many_records_take_several_messages)
{
	const struct rec *r[MAX_MESSAGES * MAX_RECORDS];
	int n;

	/* As many as the buffer holds, with room for Tracegale's own. */
	int count = CONFIG_TRACEGALE_LOGS_BUFFER_SIZE >= 2048 ? 20 : 6;

	for (int i = 0; i < count; i++) {
		LOG_INF("Reading %02d, with text that takes room", i);
	}
	check_in();
	zassert_true(srv.messages >= 2, "%d records in messages of %d bytes", count, CONFIG_TRACEGALE_MAX_MESSAGE);
	n = mine(r, ARRAY_SIZE(r));
	zassert_equal(n, count);
	for (int i = 0; i < n; i++) {
		char want[48];

		snprintf(want, sizeof(want), "Reading %02d, with text that takes room", i);
		zassert_str_equal(r[i]->text, want);
		zassert_true(i == 0 || r[i]->seq > r[i - 1]->seq);
	}
	for (int m = 1; m < srv.messages; m++) {
		zassert_not_equal(srv.msg[m].id, srv.msg[m - 1].id);
		zassert_equal(srv.msg[m].rec[0].seq, srv.msg[m - 1].rec[srv.msg[m - 1].count - 1].seq + 1, "no gaps between messages");
	}
}

static void log_while_sending(void)
{
	LOG_WRN("Logged while a message was on its way");
}

ZTEST(logs, test_what_is_logged_while_sending_goes_next)
{
	const struct rec *r[8];

	LOG_INF("First");
	flush();
	fake_reset();
	srv.during = log_while_sending;
	zassert_ok(tg_core_attempt());
	srv.during = NULL;
	zassert_true(mine(r, ARRAY_SIZE(r)) >= 1);
	zassert_str_equal(r[0]->text, "First");
	if (mine(r, ARRAY_SIZE(r)) == 1) {
		check_in();
		zassert_equal(mine(r, ARRAY_SIZE(r)), 1);
	}
	zassert_true(strstr(r[mine(r, ARRAY_SIZE(r)) - 1]->text, "while a message") != NULL);
}

/* Many check-ins with records of every length, so records wrap around the end of the buffer many times. */
ZTEST(logs, test_every_record_survives_the_buffer_wrapping)
{
	const struct rec *r[MAX_MESSAGES * MAX_RECORDS];
	static const char filler[] = "abcdefghijklmnopqrstuvwxyzabcdefghijklmnopqrstuvwxyzabcdefghijklmnopqrstuvwxyz";
	int next = 0, expected = 0;

	for (int round = 0; round < 30; round++) {
		/* At most four, which the smallest buffer holds with room to spare. */
		int count = 1 + round % 4;

		for (int i = 0; i < count; i++, next++) {
			LOG_INF("%05d %.*s", next, (next * 7) % 60, filler);
		}
		check_in();
		int n = mine(r, ARRAY_SIZE(r));

		zassert_equal(n, count, "round %d", round);
		for (int i = 0; i < n; i++, expected++) {
			char want[16];

			snprintf(want, sizeof(want), "%05d", expected);
			zassert_mem_equal(r[i]->text, want, 5, "round %d: got %s", round, r[i]->text);
			zassert_equal(r[i]->text_len, 6 + (expected * 7) % 60);
		}
	}
}

ZTEST_SUITE(logs, NULL, NULL, fake_before, NULL, NULL);
```

## src/fake.c
```c
/*
 * SPDX-FileCopyrightText: 2026 PHITES Embedded Research and Development on Engineering
 * SPDX-License-Identifier: Apache-2.0
 */

#include <string.h>
#include <zephyr/logging/log_ctrl.h>
#include <zephyr/ztest.h>

#include <tracegale/tracegale.h>

#include "core.h"
#include "fake.h"
#include "transport.h"
#include "wire.h"

struct fake_server srv;

struct cursor {
	const uint8_t *at;
};

/* Reads one CBOR head. The message has passed tg_read_message(), so it's well formed. */
static uint64_t head(struct cursor *c, uint8_t *major)
{
	uint8_t first = *c->at++;
	uint8_t info = first & 0x1f;
	uint64_t value = 0;

	*major = first >> 5;
	if (info < 24) {
		return info;
	}
	for (size_t n = 1U << (info - 24); n > 0; n--) {
		value = (value << 8) | *c->at++;
	}
	return value;
}

static uint64_t uint(struct cursor *c)
{
	uint8_t major;
	uint64_t value = head(c, &major);

	zassert_equal(major, 0, "an unsigned integer");
	return value;
}

static size_t text(struct cursor *c, char *out, size_t keep)
{
	uint8_t major;
	uint64_t len = head(c, &major);

	zassert_equal(major, 3, "text");
	for (uint64_t i = 0; i < len; i++) {
		zassert_true(c->at[i] >= 0x20 && c->at[i] < 0x7f, "only printable ASCII leaves the device");
	}
	memcpy(out, c->at, MIN(len, keep));
	out[MIN(len, keep)] = '\0';
	c->at += len;
	return len;
}

static void keep(const struct tg_message *msg, size_t len)
{
	struct logs_msg *m;
	struct cursor c = {.at = msg->body};
	uint8_t major;
	bool has_boot = false, has_records = false;

	zassert_true(srv.messages <= MAX_MESSAGES, "more messages than this test keeps");
	m = &srv.msg[srv.messages - 1];
	memset(m, 0, sizeof(*m));
	m->id = msg->id;
	m->len = len;
	for (uint32_t field = 0; field < msg->fields; field++) {
		uint64_t key = head(&c, &major);

		switch (key) {
		case 0:
			m->boot = uint(&c);
			has_boot = true;
			break;
		case 1:
			m->uptime_ms = uint(&c);
			m->has_uptime = true;
			break;
		case 2: {
			uint64_t n = head(&c, &major);

			zassert_equal(major, 4, "records are an array");
			zassert_true(n <= MAX_RECORDS, "more records in one message than this test keeps");
			m->count = n;
			for (uint64_t i = 0; i < n; i++) {
				struct rec *r = &m->rec[i];

				zassert_equal(head(&c, &major), 5, "a record has five items");
				zassert_equal(major, 4);
				r->seq = uint(&c);
				r->uptime_ms = uint(&c);
				r->level = uint(&c);
				zassert_true(r->level >= 1 && r->level <= 4, "a level from 1 to 4");
				zassert_true(text(&c, r->module, 32) <= 32, "a module of 32 bytes at most");
				r->text_len = text(&c, r->text, TEXT_KEPT);
				zassert_true(r->text_len <= 255);
				zassert_true(i == 0 || r->seq == m->rec[i - 1].seq + 1, "records in order, none missing");
			}
			has_records = true;
			break;
		}
		case 3:
			m->dropped = uint(&c);
			m->has_dropped = true;
			zassert_true(m->dropped > 0, "nothing dropped is left out");
			break;
		default:
			zassert_unreachable("field %u isn't in the specification", (unsigned int)key);
		}
	}
	zassert_true(has_boot && has_records && m->has_uptime, "boot, uptime and records are always there");
	zassert_true(m->boot != 0);
	for (int i = 0; i < m->count; i++) {
		zassert_true(m->rec[i].uptime_ms <= m->uptime_ms, "a record is older than its message");
	}
}

static int fake_open(int *detail)
{
	ARG_UNUSED(detail);
	return 0;
}

static int fake_exchange(const uint8_t *tx, size_t tx_len, uint8_t *rx, size_t rx_cap, size_t *rx_len, int *detail)
{
	struct tg_message msg;
	struct tg_writer w;

	zassert_true(tx_len <= CONFIG_TRACEGALE_MAX_MESSAGE, "a message of %zu bytes", tx_len);
	zassert_ok(tg_read_message(tx, tx_len, &msg), "the device sent a message that breaks the specification");
	tg_write_begin(&w, rx, rx_cap, TG_ACK, msg.id, 0);
	if (msg.type == TG_HELLO) {
		srv.hellos++;
	} else {
		zassert_equal(msg.type, TG_LOGS);
		srv.messages++;
		keep(&msg, tx_len);
		if (srv.during != NULL) {
			srv.during();
		}
		if (srv.lose_at == srv.messages) {
			*detail = 222;
			return -TRACEGALE_ERR_TIMEOUT;
		}
		if (srv.refuse_at == srv.messages) {
			tg_write_begin(&w, rx, rx_cap, TG_ERROR, msg.id, 1);
			tg_write_uint(&w, 0, srv.refuse_code);
		}
	}
	*rx_len = w.len;
	return 0;
}

static void fake_close(void)
{
}

const struct tg_transport *tg_transport_get(void)
{
	static const struct tg_transport transport = {.open = fake_open, .exchange = fake_exchange, .close = fake_close};

	return &transport;
}

void fake_reset(void)
{
	memset(&srv, 0, sizeof(srv));
}

void fake_flush(void)
{
#if defined(CONFIG_LOG_MODE_DEFERRED)
	while (log_process()) {
	}
#endif
}

void fake_before(void *fixture)
{
	ARG_UNUSED(fixture);
	for (int i = 0; i < 4; i++) {
		fake_flush();
		fake_reset();
		zassert_ok(tg_core_attempt());
	}
	fake_flush();
	fake_reset();
}
```

## src/fake.h
```c
/*
 * SPDX-FileCopyrightText: 2026 PHITES Embedded Research and Development on Engineering
 * SPDX-License-Identifier: Apache-2.0
 *
 * A server that answers HELLO and keeps every LOGS message it's sent, decoded, for the tests to check.
 */

#ifndef FAKE_H_
#define FAKE_H_

#include <stdbool.h>
#include <stddef.h>
#include <stdint.h>

#define MAX_MESSAGES 8
#define MAX_RECORDS  24
#define TEXT_KEPT    64

struct rec {
	uint32_t seq;
	uint64_t uptime_ms;
	uint32_t level;
	char module[33];
	/* The text's start, and its full length. */
	char text[TEXT_KEPT + 1];
	size_t text_len;
};

struct logs_msg {
	uint32_t id;
	size_t len;
	uint32_t boot;
	bool has_uptime;
	uint64_t uptime_ms;
	bool has_dropped;
	uint32_t dropped;
	int count;
	struct rec rec[MAX_RECORDS];
};

struct fake_server {
	/* Which LOGS message, counting from 1, loses its reply or is refused, and with what code. */
	int lose_at;
	int refuse_at;
	uint32_t refuse_code;
	/* Called while a LOGS message is on its way. */
	void (*during)(void);
	int hellos;
	int messages;
	struct logs_msg msg[MAX_MESSAGES];
};

extern struct fake_server srv;

void fake_reset(void);
/* Sends what's waiting, so each test starts with an empty buffer, then resets the server. */
void fake_before(void *fixture);
/* Hands records waiting in Zephyr's deferred mode to the backends. */
void fake_flush(void);

#endif /* FAKE_H_ */
```

## src/off.c
```c
/*
 * SPDX-FileCopyrightText: 2026 PHITES Embedded Research and Development on Engineering
 * SPDX-License-Identifier: Apache-2.0
 *
 * With CONFIG_TRACEGALE_LOGS=n, logging works as before, and nothing is sent.
 */

#include <zephyr/logging/log.h>
#include <zephyr/ztest.h>

#include <tracegale/tracegale.h>

#include "core.h"
#include "fake.h"

LOG_MODULE_REGISTER(test, LOG_LEVEL_INF);

ZTEST(logs_off, test_nothing_is_sent)
{
	struct tracegale_status status;

	LOG_ERR("Logged with Tracegale's logs off");
	fake_reset();
	zassert_ok(tg_core_attempt());
	zassert_equal(srv.hellos, 1);
	zassert_equal(srv.messages, 0);
	tracegale_get_status(&status);
	zassert_equal(status.logs_sent + status.logs_waiting + status.logs_dropped, 0);
}

ZTEST_SUITE(logs_off, NULL, NULL, fake_before, NULL, NULL);
```
