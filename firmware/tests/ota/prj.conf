## CMakeLists.txt
```
# SPDX-FileCopyrightText: 2026 PHITES Embedded Research and Development on Engineering
# SPDX-License-Identifier: Apache-2.0

cmake_minimum_required(VERSION 3.20.0)
find_package(Zephyr REQUIRED HINTS $ENV{ZEPHYR_BASE})
project(tracegale_ota_test)

target_include_directories(app PRIVATE ${ZEPHYR_TRACEGALE_MODULE_DIR}/firmware/src)
target_sources(app PRIVATE src/fake.c)
if(CONFIG_TRACEGALE_OTA_CONFIRM)
  target_sources(app PRIVATE src/main.c)
else()
  target_sources(app PRIVATE src/options.c)
endif()
```

## Kconfig
```
# SPDX-FileCopyrightText: 2026 PHITES Embedded Research and Development on Engineering
# SPDX-License-Identifier: Apache-2.0

# These tests need CONFIG_BOOTLOADER_MCUBOOT on native_sim, where a stand-in plays MCUboot. Before Zephyr v4.5 that option
# can't be chosen there, because it wants an image that's linked at an offset in flash. Nothing is linked differently for
# native_sim, so saying yes here is safe, and only these tests do it.
config HAS_FLASH_LOAD_OFFSET
	default y

source "Kconfig.zephyr"
```

## prj.conf
```kconfig
# SPDX-FileCopyrightText: 2026 PHITES Embedded Research and Development on Engineering
# SPDX-License-Identifier: Apache-2.0

CONFIG_ZTEST=y
CONFIG_TRACEGALE=y
CONFIG_TRACEGALE_TRANSPORT_CUSTOM=y
CONFIG_TRACEGALE_AUTOSTART=n
CONFIG_TEST_RANDOM_GENERATOR=y
CONFIG_ENTROPY_GENERATOR=y
# What an application with MCUboot and settings storage has. With these, the one line turns updates on.
CONFIG_BOOTLOADER_MCUBOOT=y
CONFIG_FLASH=y
CONFIG_FLASH_MAP=y
CONFIG_NVS=y
CONFIG_SETTINGS=y
CONFIG_SETTINGS_NVS=y
# Writing flash that wasn't erased is an error here, as it is on real NOR flash.
CONFIG_FLASH_SIMULATOR_DOUBLE_WRITES=n
# Small, so that an image of a few pages takes many messages.
CONFIG_TRACEGALE_MAX_MESSAGE=256
# A whole check-in runs on the test's own stack, as it would on Tracegale's thread.
CONFIG_ZTEST_STACK_SIZE=4096
# Each suite tests one feature. Reports of metrics have their own, in tests/metrics.
CONFIG_TRACEGALE_METRICS=n
# Logs have their own suite, in tests/logs.
CONFIG_TRACEGALE_LOGS=n
```

## app.overlay
```dts
/*
 * SPDX-FileCopyrightText: 2026 PHITES Embedded Research and Development on Engineering
 * SPDX-License-Identifier: Apache-2.0
 *
 * The simulator's flash takes single bytes. Real flash is often written in blocks, so these tests use blocks of 8.
 */

&flash0 {
	write-block-size = <8>;
};
```

## src/fake.c
```c
/*
 * SPDX-FileCopyrightText: 2026 PHITES Embedded Research and Development on Engineering
 * SPDX-License-Identifier: Apache-2.0
 *
 * A fake server for the update tests, following "Server to device: firmware images" in docs/protocol/README.md, and a
 * stand-in for MCUboot that does to the two slots what MCUboot does at a restart.
 */

#include <string.h>

#include <zephyr/dfu/mcuboot.h>
#include <zephyr/kernel.h>
#include <zephyr/settings/settings.h>
#include <zephyr/storage/flash_map.h>
#include <zephyr/sys/byteorder.h>
#include <zephyr/ztest.h>

#include <tracegale/tracegale.h>

#include "core.h"
#include "fake.h"
#include "ota.h"
#include "sha256.h"
#include "transport.h"
#include "wire.h"

#define RECORD_NAME "tracegale/ota"
/* MCUboot's trailer, counted from the end of a slot. */
#define TRAILER_MAGIC 16
#define TRAILER_IMAGE_OK 24
#define TRAILER_COPY_DONE 32

static const uint8_t magic[16] = {0x77, 0xc2, 0x95, 0xf3, 0x60, 0xd2, 0xef, 0x7f,
				  0x35, 0x52, 0x50, 0x0f, 0x2c, 0xb6, 0x79, 0x80};

struct fake_server srv;
struct restarts restarts;
bool bootloader_refuses;

/* The image that ran before the one on trial, which MCUboot keeps in the second slot. */
static uint8_t previous[IMAGE_MAX];
static uint8_t moving[IMAGE_MAX];

/* ---- The server ---- */

static void reply_ack(uint8_t *rx, size_t cap, size_t *rx_len, uint32_t id, bool pending)
{
	struct tg_writer w;

	tg_write_begin(&w, rx, cap, TG_ACK, id, pending ? 1 : 0);
	if (pending) {
		tg_write_uint(&w, 0, TG_PENDING_UPDATE);
	}
	*rx_len = w.len;
}

static void reply_error(uint8_t *rx, size_t cap, size_t *rx_len, uint32_t id, uint32_t code)
{
	struct tg_writer w;

	tg_write_begin(&w, rx, cap, TG_ERROR, id, 1);
	tg_write_uint(&w, 0, code);
	*rx_len = w.len;
}

static int dropped(int *detail)
{
	*detail = 113;
	return -TRACEGALE_ERR_TIMEOUT;
}

static int fake_exchange(const uint8_t *tx, size_t tx_len, uint8_t *rx, size_t cap, size_t *rx_len, int *detail)
{
	struct tg_message m;
	struct tg_writer w;
	uint32_t image_ref;
	uint32_t at;
	uint32_t len;

	zassert_ok(tg_read_message(tx, tx_len, &m), "the device sent a message that breaks the specification");
	switch (m.type) {
	case TG_HELLO:
		srv.hellos++;
		reply_ack(rx, cap, rx_len, m.id, srv.pending);
		return 0;
	case TG_IMG_CHECK:
		srv.checks++;
		srv.first_seen = false;
		if (srv.error_on_check != 0) {
			reply_error(rx, cap, rx_len, m.id, srv.error_on_check);
			return 0;
		}
		if (!srv.offer) {
			reply_ack(rx, cap, rx_len, m.id, false);
			return 0;
		}
		tg_write_begin(&w, rx, cap, TG_IMG_OFFER, m.id, 5);
		tg_write_uint(&w, 0, srv.image_ref);
		tg_write_uint(&w, 1, srv.total_len);
		tg_write_uint(&w, 2, srv.kind);
		tg_write_text(&w, 4, "1.3.0");
		tg_write_bytes(&w, 5, srv.sha, sizeof(srv.sha));
		zassert_false(w.overflow);
		*rx_len = w.len;
		return 0;
	case TG_IMG_GET:
		srv.gets++;
		if (srv.drop_get_at == srv.gets) {
			return dropped(detail);
		}
		if (srv.on_get != NULL) {
			srv.on_get();
		}
		zassert_true(tg_read_uint(&m, 0, &image_ref) && tg_read_uint(&m, 1, &at) && tg_read_uint(&m, 2, &len));
		if (srv.error_on_get != 0) {
			reply_error(rx, cap, rx_len, m.id, srv.error_on_get);
			return 0;
		}
		if (!srv.offer || image_ref != srv.image_ref) {
			reply_error(rx, cap, rx_len, m.id, TG_WIRE_ERR_UNKNOWN_IMAGE);
			return 0;
		}
		if (at > srv.total_len) {
			reply_error(rx, cap, rx_len, m.id, TG_WIRE_ERR_BAD_OFFSET);
			return 0;
		}
		zassert_true(len > 0 && len <= BLOCK, "the device asked for %u bytes", len);
		zassert_equal(at % 8, 0, "a download continues at a whole write block, not at %u", at);
		if (!srv.first_seen) {
			srv.first_seen = true;
			srv.first_offset = at;
		}
		len = MIN(MIN(len, srv.chunk_max), srv.total_len - at);
		tg_write_begin(&w, rx, cap, TG_IMG_DATA, m.id, 3);
		tg_write_uint(&w, 0, srv.wrong_ref ? image_ref + 1 : image_ref);
		tg_write_uint(&w, 1, srv.wrong_offset ? at + 8 : at);

		uint8_t *data = tg_write_bytes_reserve(&w, 2, len);

		zassert_true(data != NULL && !w.overflow, "the reply fits the size the device announced");
		memcpy(data, &srv.image[at], len);
		if (srv.corrupt_at >= (int)at && srv.corrupt_at < (int)(at + len)) {
			data[srv.corrupt_at - at] ^= 0x01;
		}
		srv.bytes_sent += len;
		*rx_len = w.len;
		return 0;
	case TG_IMG_RESULT:
		srv.results++;
		if (srv.drop_result_at == srv.results) {
			return dropped(detail);
		}
		zassert_true(srv.results <= RESULTS);
		zassert_true(tg_read_uint(&m, 0, &srv.result_ref[srv.results - 1]));
		zassert_true(tg_read_uint(&m, 1, &srv.result_outcome[srv.results - 1]));
		if (srv.error_on_result != 0) {
			reply_error(rx, cap, rx_len, m.id, srv.error_on_result);
			return 0;
		}
		reply_ack(rx, cap, rx_len, m.id, false);
		return 0;
	default:
		zassert_unreachable("the device sent message type %u", m.type);
		return -TRACEGALE_ERR_BAD_REPLY;
	}
}

static int fake_open(int *detail)
{
	if (srv.offline) {
		*detail = 101;
		return -TRACEGALE_ERR_CONNECT;
	}
	return 0;
}

static void fake_close(void)
{
}

static const struct tg_transport fake = {.open = fake_open, .exchange = fake_exchange, .close = fake_close};

const struct tg_transport *tg_transport_get(void)
{
	return &fake;
}

void fake_server_reset(void)
{
	memset(&srv, 0, sizeof(srv));
	srv.chunk_max = UINT32_MAX;
	srv.corrupt_at = -1;
}

void offer(const uint8_t *image, size_t len, uint32_t image_ref)
{
	struct tg_sha256 ctx;

	srv.pending = true;
	srv.offer = true;
	srv.image = image;
	srv.total_len = len;
	srv.image_ref = image_ref;
	tg_sha256_init(&ctx);
	tg_sha256_update(&ctx, image, len);
	tg_sha256_final(&ctx, srv.sha);
}

uint32_t last_outcome(void)
{
	return srv.results == 0 ? 0 : srv.result_outcome[srv.results - 1];
}

/* ---- The device ---- */

void tracegale_update_restart(enum tracegale_restart_reason reason)
{
	if (reason == TRACEGALE_RESTART_INSTALL) {
		restarts.install++;
	} else {
		restarts.revert++;
	}
}

int checkin(void)
{
	return tg_core_attempt();
}

enum tracegale_update_state update_state(void)
{
	struct tracegale_status status;

	tracegale_get_status(&status);
	return status.update_state;
}

enum tracegale_update_result update_result(void)
{
	struct tracegale_status status;

	tracegale_get_status(&status);
	return status.update_result;
}

uint32_t update_offset(void)
{
	struct tracegale_status status;

	tracegale_get_status(&status);
	return status.update_offset;
}

size_t image_start(void)
{
	return IS_ENABLED(CONFIG_MCUBOOT_BOOTLOADER_MODE_SWAP_USING_OFFSET) ? PAGE : 0;
}

size_t slot_room(void)
{
	const struct flash_area *fa;
	size_t size;

	zassert_ok(flash_area_open(SLOT1, &fa));
	size = fa->fa_size;
	flash_area_close(fa);
	return size - image_start();
}

void make_image(uint8_t *out, size_t len, uint8_t minor, uint32_t seed)
{
	uint32_t x = seed * 2654435761U + 1;

	for (size_t i = 0; i < len; i++) {
		x = x * 1664525U + 1013904223U;
		out[i] = x >> 24;
	}
	memset(out, 0, 32);
	sys_put_le32(0x96f3b83dU, out);
	/* Major, minor, revision and build. */
	out[20] = 1;
	out[21] = minor;
}

static const struct flash_area *open_area(uint8_t area)
{
	const struct flash_area *fa;

	zassert_ok(flash_area_open(area, &fa));
	return fa;
}

static void erase_slot(uint8_t area)
{
	const struct flash_area *fa = open_area(area);

	zassert_ok(flash_area_erase(fa, 0, fa->fa_size));
	flash_area_close(fa);
}

void scribble(uint8_t area, size_t at, const uint8_t *data, size_t len)
{
	const struct flash_area *fa = open_area(area);
	uint8_t block[8];

	zassert_equal(at % sizeof(block), 0);
	zassert_ok(flash_area_write(fa, at, data, ROUND_DOWN(len, sizeof(block))));
	if (len % sizeof(block) != 0) {
		memset(block, 0xff, sizeof(block));
		memcpy(block, &data[ROUND_DOWN(len, sizeof(block))], len % sizeof(block));
		zassert_ok(flash_area_write(fa, at + ROUND_DOWN(len, sizeof(block)), block, sizeof(block)));
	}
	flash_area_close(fa);
}

bool in_slot(uint8_t area, size_t at, const uint8_t *data, size_t len)
{
	const struct flash_area *fa = open_area(area);
	uint8_t block[64];
	bool same = true;

	for (size_t done = 0; same && done < len; done += sizeof(block)) {
		size_t n = MIN(sizeof(block), len - done);

		zassert_ok(flash_area_read(fa, at + done, block, n));
		same = memcmp(block, &data[done], n) == 0;
	}
	flash_area_close(fa);
	return same;
}

bool blank_from(uint8_t area, size_t at)
{
	const struct flash_area *fa = open_area(area);
	uint8_t block[64];
	bool blank = true;

	for (; blank && at < fa->fa_size; at += sizeof(block)) {
		size_t n = MIN(sizeof(block), fa->fa_size - at);

		zassert_ok(flash_area_read(fa, at, block, n));
		for (size_t i = 0; i < n; i++) {
			blank = blank && block[i] == 0xff;
		}
	}
	flash_area_close(fa);
	return blank;
}

static void trailer_read(uint8_t area, size_t from_end, uint8_t *out, size_t len)
{
	const struct flash_area *fa = open_area(area);

	zassert_ok(flash_area_read(fa, fa->fa_size - from_end, out, len));
	flash_area_close(fa);
}

static void trailer_write(uint8_t area, size_t from_end, const uint8_t *data, size_t len)
{
	const struct flash_area *fa = open_area(area);
	size_t at = fa->fa_size - from_end;

	flash_area_close(fa);
	scribble(area, at, data, len);
}

static bool has_magic(uint8_t area)
{
	uint8_t found[sizeof(magic)];

	trailer_read(area, TRAILER_MAGIC, found, sizeof(found));
	return memcmp(found, magic, sizeof(magic)) == 0;
}

static void read_image(uint8_t area, size_t at, uint8_t *out)
{
	const struct flash_area *fa = open_area(area);

	zassert_ok(flash_area_read(fa, at, out, IMAGE_MAX));
	flash_area_close(fa);
}

/* What MCUboot does before the application starts. */
static void bootloader(void)
{
	static const uint8_t set = 0x01;
	uint8_t flag;

	if (has_magic(SLOT1)) {
		/* An image was requested. */
		if (bootloader_refuses) {
			bootloader_refuses = false;
			erase_slot(SLOT1);
			return;
		}
		read_image(SLOT1, image_start(), moving);
		read_image(SLOT0, 0, previous);
		erase_slot(SLOT0);
		erase_slot(SLOT1);
		scribble(SLOT0, 0, moving, IMAGE_MAX);
		if (IS_ENABLED(CONFIG_MCUBOOT_BOOTLOADER_MODE_OVERWRITE_ONLY)) {
			/* Nothing is kept of the previous image, and the new one isn't on trial. */
			return;
		}
		scribble(SLOT1, image_start(), previous, IMAGE_MAX);
		trailer_write(SLOT0, TRAILER_MAGIC, magic, sizeof(magic));
		trailer_write(SLOT0, TRAILER_COPY_DONE, &set, 1);
		return;
	}
	if (!has_magic(SLOT0)) {
		return;
	}
	trailer_read(SLOT0, TRAILER_IMAGE_OK, &flag, 1);
	if (flag != set) {
		/* The image on trial wasn't confirmed, so the previous one comes back, for good. */
		erase_slot(SLOT0);
		erase_slot(SLOT1);
		scribble(SLOT0, 0, previous, IMAGE_MAX);
		trailer_write(SLOT0, TRAILER_MAGIC, magic, sizeof(magic));
		trailer_write(SLOT0, TRAILER_COPY_DONE, &set, 1);
		trailer_write(SLOT0, TRAILER_IMAGE_OK, &set, 1);
	}
}

void device_restart(void)
{
	bootloader();
	/* RAM starts again. */
	tracegale_update_pause(false);
	tg_ota_boot();
}

void device_reset(const uint8_t *running, size_t len)
{
	erase_slot(SLOT0);
	erase_slot(SLOT1);
	scribble(SLOT0, 0, running, len);
	(void)settings_delete(RECORD_NAME);
	bootloader_refuses = false;
	device_restart();
	/* A trial that an earlier test left behind ends before this test starts. */
	k_sleep(K_SECONDS(CONFIG_TRACEGALE_OTA_CONFIRM_TIMEOUT_S + 1));
	memset(&restarts, 0, sizeof(restarts));
	device_restart();
}

void confirm_running(void)
{
	zassert_ok(boot_write_img_confirmed());
}

static struct record found;
static bool found_any;

static int record_cb(const char *key, size_t len, settings_read_cb read_cb, void *cb_arg, void *param)
{
	ARG_UNUSED(key);
	ARG_UNUSED(param);
	zassert_equal(len, sizeof(found), "the stored record changed size");
	zassert_equal(read_cb(cb_arg, &found, len), (ssize_t)len);
	found_any = true;
	return 0;
}

bool record_read(struct record *out)
{
	found_any = false;
	zassert_ok(settings_load_subtree_direct(RECORD_NAME, record_cb, NULL));
	if (found_any) {
		*out = found;
	}
	return found_any;
}

void record_write(const void *in, size_t len)
{
	zassert_ok(settings_save_one(RECORD_NAME, in, len));
}
```

## src/fake.h
```c
/*
 * SPDX-FileCopyrightText: 2026 PHITES Embedded Research and Development on Engineering
 * SPDX-License-Identifier: Apache-2.0
 *
 * What the update tests share: a fake server, a stand-in for MCUboot, and images to offer.
 */

#ifndef TG_TEST_FAKE_H_
#define TG_TEST_FAKE_H_

#include <stdbool.h>
#include <stddef.h>
#include <stdint.h>

#include <zephyr/storage/flash_map.h>

#include <tracegale/tracegale.h>

#include "compat.h"
#include "sha256.h"

#define SLOT0 TG_PARTITION_ID(slot0_partition)
#define SLOT1 TG_PARTITION_ID(slot1_partition)
#define PAGE 4096
/* The most image data one IMG_GET asks for with these tests' message size: whole write blocks under 256 - 25. */
#define BLOCK 224
/* Results the server remembers. */
#define RESULTS 8

struct fake_server {
	/* What it has for the device. */
	bool pending;
	bool offer;
	uint32_t image_ref;
	uint32_t kind;
	const uint8_t *image;
	uint32_t total_len;
	uint8_t sha[TG_SHA256_SIZE];
	/* The most data it puts in one IMG_DATA. */
	uint32_t chunk_max;

	/* What goes wrong. */
	bool offline;
	/* The connection drops at this IMG_GET or IMG_RESULT, counted from 1. */
	int drop_get_at;
	int drop_result_at;
	/* Error codes it answers with, or 0. */
	uint32_t error_on_check;
	uint32_t error_on_get;
	uint32_t error_on_result;
	/* A byte of the image that's sent wrong, or -1. */
	int corrupt_at;
	bool wrong_ref;
	bool wrong_offset;
	/* Called at each IMG_GET, before it's answered. */
	void (*on_get)(void);

	/* What it saw. */
	int hellos;
	int checks;
	int gets;
	int results;
	uint32_t bytes_sent;
	/* The offset of the first IMG_GET after the last IMG_CHECK. */
	uint32_t first_offset;
	bool first_seen;
	uint32_t result_ref[RESULTS];
	uint32_t result_outcome[RESULTS];
};

extern struct fake_server srv;

/* Starts the server again: nothing to offer, nothing seen and nothing going wrong. */
void fake_server_reset(void);

/* Has the server announce and offer this image. */
void offer(const uint8_t *image, size_t len, uint32_t image_ref);

/* The last outcome the device reported. */
uint32_t last_outcome(void);

/* How often Tracegale asked for a restart, and why. The device doesn't restart by itself in these tests. */
struct restarts {
	int install;
	int revert;
};

extern struct restarts restarts;

/* Where MCUboot's mode in this build expects an image in the second slot. */
size_t image_start(void);

/* How much image fits the second slot. */
size_t slot_room(void);

/* The stand-in for MCUboot refuses the next image, as it would with a wrong signature. */
extern bool bootloader_refuses;

/* A restart: MCUboot installs a requested image, or brings the previous one back if the new one wasn't confirmed. Then
 * Tracegale starts.
 */
void device_restart(void);

/* Puts the device back as new: this image in the first slot, an empty second slot, and no record of any update. */
void device_reset(const uint8_t *running, size_t len);

/* The largest image these tests use. The stand-in for MCUboot moves this much of a slot. */
#define IMAGE_MAX (4 * PAGE)

/* Fills an image: MCUboot's header with version 1.<minor>.0, then bytes that depend on the seed. */
void make_image(uint8_t *out, size_t len, uint8_t minor, uint32_t seed);

/* One whole check-in, as Tracegale's thread makes it. @return 0, or a negative tracegale_error. */
int checkin(void);

/* What tracegale_get_status() says about updates. */
enum tracegale_update_state update_state(void);
enum tracegale_update_result update_result(void);
uint32_t update_offset(void);

/* @return true if the slot holds exactly these bytes there. */
bool in_slot(uint8_t area, size_t at, const uint8_t *data, size_t len);

/* @return true if the slot is blank from there to its end. */
bool blank_from(uint8_t area, size_t at);

/* Writes bytes into a slot, at a multiple of 8. */
void scribble(uint8_t area, size_t at, const uint8_t *data, size_t len);

/* MCUboot's confirmation of the running image, as an application gives it. */
void confirm_running(void);

/* What Tracegale keeps in settings storage. A device in the field has this, so it must not change. */
struct record {
	uint8_t version;
	uint8_t phase;
	uint8_t outcome;
	uint8_t failures;
	uint8_t streak;
	uint8_t reserved[3];
	uint32_t image_ref;
	uint32_t total_len;
	uint8_t sha256[TG_SHA256_SIZE];
};

/* Reads the record. @return false when there's none. */
bool record_read(struct record *out);
void record_write(const void *in, size_t len);

#endif /* TG_TEST_FAKE_H_ */
```

## src/options.c
```c
/*
 * SPDX-FileCopyrightText: 2026 PHITES Embedded Research and Development on Engineering
 * SPDX-License-Identifier: Apache-2.0
 *
 * The update options an application can change: it confirms images itself (CONFIG_TRACEGALE_OTA_CONFIRM=n), no restart
 * is asked for an unconfirmed image (CONFIG_TRACEGALE_OTA_CONFIRM_TIMEOUT_S=0), older images are taken
 * (CONFIG_TRACEGALE_OTA_DOWNGRADE=y), and there's no wait after a failed update (CONFIG_TRACEGALE_OTA_HOLD_S=0).
 */

#include <string.h>

#include <zephyr/kernel.h>
#include <zephyr/ztest.h>

#include <tracegale/tracegale.h>

#include "fake.h"
#include "store.h"

#define LEN_BASE 9001
#define LEN_NEXT 10003
#define GETS_NEXT DIV_ROUND_UP(LEN_NEXT, BLOCK)

static uint8_t base[LEN_BASE];
static uint8_t next[LEN_NEXT];
static uint8_t older[LEN_NEXT];

static void *setup(void)
{
	make_image(base, sizeof(base), 2, 1);
	make_image(next, sizeof(next), 3, 2);
	make_image(older, sizeof(older), 1, 4);
	tg_store_load();
	return NULL;
}

static void before(void *fixture)
{
	ARG_UNUSED(fixture);
	fake_server_reset();
	device_reset(base, sizeof(base));
}

ZTEST(ota_options, test_application_confirms)
{
	offer(next, sizeof(next), 5);
	zassert_ok(checkin());
	device_restart();
	zassert_equal(update_state(), TRACEGALE_UPDATE_TESTING);

	/* Reaching the server isn't enough for this application. */
	zassert_ok(checkin());
	zassert_ok(checkin());
	zassert_equal(srv.results, 0);
	zassert_equal(srv.checks, 1, "no other update is taken during a trial");
	zassert_equal(update_state(), TRACEGALE_UPDATE_TESTING);
	k_sleep(K_HOURS(48));
	zassert_equal(restarts.revert, 0, "without a time limit, Tracegale never asks for a restart");

	confirm_running();
	zassert_ok(checkin());
	zassert_equal(srv.results, 1);
	zassert_equal(last_outcome(), TRACEGALE_UPDATE_INSTALLED);
	zassert_equal(update_state(), TRACEGALE_UPDATE_NONE);
}

ZTEST(ota_options, test_application_confirms_and_restarts)
{
	offer(next, sizeof(next), 5);
	zassert_ok(checkin());
	device_restart();
	confirm_running();
	device_restart();
	zassert_true(in_slot(SLOT0, 0, next, sizeof(next)));
	zassert_ok(checkin());
	zassert_equal(last_outcome(), TRACEGALE_UPDATE_INSTALLED);
}

ZTEST(ota_options, test_application_does_not_confirm)
{
	offer(next, sizeof(next), 5);
	zassert_ok(checkin());
	device_restart();
	zassert_ok(checkin());
	/* Restarted by the application, or by a crash. */
	device_restart();
	zassert_true(in_slot(SLOT0, 0, base, sizeof(base)));
	zassert_ok(checkin());
	zassert_equal(last_outcome(), TRACEGALE_UPDATE_REVERTED);
}

ZTEST(ota_options, test_older_image_taken)
{
	offer(older, sizeof(older), 5);
	zassert_ok(checkin());
	zassert_equal(update_state(), TRACEGALE_UPDATE_RESTART_PENDING);
	device_restart();
	zassert_true(in_slot(SLOT0, 0, older, sizeof(older)));
}

ZTEST(ota_options, test_no_wait_after_a_failed_update)
{
	offer(next, sizeof(next), 5);
	srv.corrupt_at = 100;
	zassert_ok(checkin());
	zassert_equal(last_outcome(), TRACEGALE_UPDATE_DAMAGED);
	srv.corrupt_at = -1;
	zassert_ok(checkin());
	zassert_equal(srv.checks, 2);
	zassert_equal(srv.gets, 2 * GETS_NEXT);
	zassert_equal(update_state(), TRACEGALE_UPDATE_RESTART_PENDING);
}

ZTEST_SUITE(ota_options, NULL, setup, before, NULL, NULL);
```
