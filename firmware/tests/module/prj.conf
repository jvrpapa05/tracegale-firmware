## CMakeLists.txt
```
# SPDX-FileCopyrightText: 2026 PHITES Embedded Research and Development on Engineering
# SPDX-License-Identifier: Apache-2.0

cmake_minimum_required(VERSION 3.20.0)
find_package(Zephyr REQUIRED HINTS $ENV{ZEPHYR_BASE})
project(tracegale_module_test)

target_sources(app PRIVATE src/main.c)
```

## prj.conf
```kconfig
CONFIG_ZTEST=y
CONFIG_TRACEGALE=y
```

## src/main.c
```c
/*
 * SPDX-FileCopyrightText: 2026 PHITES Embedded Research and Development on Engineering
 * SPDX-License-Identifier: Apache-2.0
 */

#include <string.h>

#include <zephyr/ztest.h>

#include <tracegale/version.h>

ZTEST(tracegale_module, test_version_matches_header)
{
	zassert_equal(strcmp(tracegale_version(), TRACEGALE_VERSION_STRING), 0,
		      "unexpected version: %s", tracegale_version());
}

ZTEST_SUITE(tracegale_module, NULL, NULL, NULL, NULL, NULL);
```
